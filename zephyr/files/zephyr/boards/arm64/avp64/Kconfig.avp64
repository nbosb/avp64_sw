## zephyr/files/zephyr/boards/arm64/avp64/Kconfig.avp64
```kconfig
##############################################################################
#                                                                            #
# Copyright 2024  Nils Bosbach                                               #
#                                                                            #
# This software is licensed under the Apache license.                        #
# A copy of the license can be found in the LICENSE file at the root         #
# of the source tree.                                                        #
#                                                                            #
##############################################################################

config BOARD_AVP64
    select SOC_AVP64
```

## zephyr/files/zephyr/boards/arm64/avp64/Kconfig.defconfig
```kconfig
##############################################################################
#                                                                            #
# Copyright 2024  Nils Bosbach                                               #
#                                                                            #
# This software is licensed under the Apache license.                        #
# A copy of the license can be found in the LICENSE file at the root         #
# of the source tree.                                                        #
#                                                                            #
##############################################################################

if BOARD_AVP64

config BUILD_OUTPUT_BIN
	default y

endif # BOARD_AVP64
```

## zephyr/files/zephyr/boards/arm64/avp64/avp64_avp64_x8_defconfig
```kconfig
##############################################################################
#                                                                            #
# Copyright 2024  Nils Bosbach                                               #
#                                                                            #
# This software is licensed under the Apache license.                        #
# A copy of the license can be found in the LICENSE file at the root         #
# of the source tree.                                                        #
#                                                                            #
##############################################################################

CONFIG_ARM_ARCH_TIMER=y

# Cache management
CONFIG_CACHE_MANAGEMENT=y

# Enable UART driver
CONFIG_SERIAL=y

# Enable console
CONFIG_CONSOLE=y
CONFIG_UART_CONSOLE=y

# Enable serial port
CONFIG_UART_PL011=y
CONFIG_UART_INTERRUPT_DRIVEN=y

# SMP-related
CONFIG_SMP=y
CONFIG_MP_MAX_NUM_CPUS=8
CONFIG_TIMEOUT_64BIT=y
```

## zephyr/files/zephyr/boards/arm64/avp64/board.yml
```yaml
##############################################################################
#                                                                            #
# Copyright 2024  Nils Bosbach                                               #
#                                                                            #
# This software is licensed under the Apache license.                        #
# A copy of the license can be found in the LICENSE file at the root         #
# of the source tree.                                                        #
#                                                                            #
##############################################################################

board:
  name: avp64
  vendor: arm64
  socs:
  - name: avp64
    variants:
    - name: x1
    - name: x2
    - name: x4
    - name: x8
```

## zephyr/files/zephyr/soc/arm64/avp64/Kconfig
```kconfig
##############################################################################
#                                                                            #
# Copyright 2024  Nils Bosbach                                               #
#                                                                            #
# This software is licensed under the Apache license.                        #
# A copy of the license can be found in the LICENSE file at the root         #
# of the source tree.                                                        #
#                                                                            #
##############################################################################

config SOC_AVP64
	select ARM64
	select CPU_CORTEX_A
	select ARMV8_A
```

## zephyr/files/zephyr/soc/arm64/avp64/Kconfig.soc
```kconfig
##############################################################################
#                                                                            #
# Copyright 2024  Nils Bosbach                                               #
#                                                                            #
# This software is licensed under the Apache license.                        #
# A copy of the license can be found in the LICENSE file at the root         #
# of the source tree.                                                        #
#                                                                            #
##############################################################################

config SOC_AVP64
	bool

config SOC
	default "avp64" if SOC_AVP64
```

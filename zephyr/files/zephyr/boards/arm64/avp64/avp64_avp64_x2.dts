/******************************************************************************
 *                                                                            *
 * Copyright 2024 Nils Bosbach                                                *
 *                                                                            *
 * This software is licensed under the Apache license.                        *
 * A copy of the license can be found in the LICENSE file at the root         *
 * of the source tree.                                                        *
 *                                                                            *
 ******************************************************************************/

#define NR_CPU 2
#include "avp64.dts"
